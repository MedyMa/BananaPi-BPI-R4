## immortalwrt/MT7988/defconfig
```kconfig
# ImmortalWrt mt798x-mt799x-6.6-mtwifi defconfig draft for BananaPi BPI-R4.
# This keeps the branch's MT7990/Eagle WiFi 7 layout for BPI-R4, then nudges
# the vendor stack toward NIC-BE14 by selecting the BE14000 custom hwifi blob.
# The mt_wifi7 profile in this tree still maps Eagle to the BE19000 SKU string.

CONFIG_TARGET_mediatek=y
CONFIG_TARGET_mediatek_filogic_a73=y
CONFIG_TARGET_mediatek_filogic_a73_DEVICE_bananapi_bpi-r4=y
CONFIG_TARGET_SUBTARGET="filogic_a73"
CONFIG_DEFAULT_TARGET_OPTIMIZATION="-Os -pipe -march=armv8-a+crypto+crc -mtune=cortex-a73"
CONFIG_CPU_TYPE="generic+cortex-a73"
CONFIG_TARGET_OPTIMIZATION="-Os -pipe -march=armv8-a+crypto+crc -mtune=cortex-a73"
CONFIG_PACKAGE_kmod-mediatek_hnat=y
CONFIG_DEVEL=y
CONFIG_CCACHE=y
CONFIG_TOOLCHAINOPTS=y
# CONFIG_TARGET_ROOTFS_INITRAMFS is not set
CONFIG_TARGET_ROOTFS_PARTSIZE=8192
CONFIG_UNETD_VXLAN_SUPPORT=y
CONFIG_VPNC_GNUTLS=y
CONFIG_ZRAM_DEF_COMP_LZORLE=y
CONFIG_IPV6=y
CONFIG_DRIVER_11AC_SUPPORT=y
CONFIG_DRIVER_11AX_SUPPORT=y
CONFIG_DRIVER_11BE_SUPPORT=y
# Keep the upstream mt76/mt7996 path out of the vendor WiFi7 build.
# CONFIG_PACKAGE_kmod-mt7996-firmware is not set
# CONFIG_PACKAGE_kmod-mt7996-233-firmware is not set

# Keep the nftables firewall / IPv6 userspace explicit.
CONFIG_PACKAGE_firewall4=y
CONFIG_PACKAGE_odhcp6c=y
CONFIG_PACKAGE_odhcpd-ipv6only=y
CONFIG_PACKAGE_iptables-nft=y
CONFIG_PACKAGE_ip6tables-nft=y
CONFIG_PACKAGE_ppp=y
CONFIG_PACKAGE_ppp-mod-pppoe=y

# MTK vendor WiFi 7 block aligned to mt798x-mt799x-6.6-mtwifi.
CONFIG_PACKAGE_datconf=y
CONFIG_PACKAGE_datconf-lua=y
CONFIG_PACKAGE_mii_mgr=y
CONFIG_PACKAGE_mtk-smp=y
CONFIG_PACKAGE_mtkhqos_util=y
CONFIG_PACKAGE_mtwifi-cfg=y
CONFIG_PACKAGE_mtwifi-wapp=y
CONFIG_PACKAGE_wifi-scripts=y
CONFIG_PACKAGE_regs=y
CONFIG_PACKAGE_switch=y
CONFIG_PACKAGE_kmod-cfg80211=y
CONFIG_PACKAGE_kmod-mac80211=y
CONFIG_PACKAGE_kmod-mt_hwifi=y
CONFIG_MTK_HWIFI_PCI_SUPPORT=y
CONFIG_MTK_HWIFI_CONNAC_IF_SUPPORT=y
CONFIG_MTK_HWIFI_WED_SUPPORT=y
CONFIG_MTK_HWIFI_FW_BE14000=y
CONFIG_MTK_HWIFI_FW_BE14000_20260721=y
CONFIG_MTK_HWIFI_FW_PATH_BE14000="BE14000-20260721"
CONFIG_MTK_HWIFI_MT7990=y
CONFIG_MTK_HWIFI_MT7991=y
CONFIG_PACKAGE_kmod-connac_if=y
CONFIG_PACKAGE_kmod-mt7990=y
CONFIG_PACKAGE_kmod-mt7990_dbg=y
CONFIG_MTK_HWIFI_MT7990_RRO_SUPPORT="Y"
CONFIG_MTK_HWIFI_MT7990_OPTION_TYPE=2
CONFIG_MTK_HWIFI_MT7990_INTR_OPTION_SET=0
CONFIG_PACKAGE_kmod-mt7991=y
CONFIG_PACKAGE_kmod-mtk_pci=y
# CONFIG_PACKAGE_kmod-mt_wifi_cmn is not set
CONFIG_PACKAGE_kmod-mtk_wed=y
CONFIG_PACKAGE_kmod-mt_wifi7=y
CONFIG_PACKAGE_kmod-warp=y
CONFIG_PACKAGE_mt7988-wo-firmware=y
CONFIG_WARP_CONFIG_MODE=0
CONFIG_WARP_VERSION="3"
CONFIG_WARP_DBG_SUPPORT=y
CONFIG_WED_HW_RRO_SUPPORT=y
# CONFIG_MTK_MEMORY_SHRINK is not set
CONFIG_WARP_MEMORY_LEAK_DBG=y
CONFIG_WARP_CHIPSET="mt7988"
CONFIG_MTK_WIFI7_SUPPORT_OPENWRT=y
CONFIG_MTK_WIFI7_DRIVER=y
CONFIG_MTK_WIFI7_UNIFIED_COMMAND=y
CONFIG_MTK_WIFI7_DOT11_N_SUPPORT=y
CONFIG_MTK_WIFI7_DOT11_AX_SUPPORT=y
CONFIG_MTK_WIFI7_DOT11_BE_SUPPORT=y
CONFIG_MTK_WIFI7_MT_MAC=y
CONFIG_MTK_WIFI7_CHIP_MT7990=y
CONFIG_MTK_WIFI7_FIRST_IF_MT7990=y
CONFIG_MTK_WIFI7_SECOND_IF_MT7990=y
CONFIG_MTK_THIRD_IF_MT7990=y
CONFIG_MTK_WIFI7_FIRST_IF_RF_OFFSET=0xc0000
CONFIG_MTK_WIFI7_SECOND_IF_RF_OFFSET=0xc8000
CONFIG_MTK_WIIF7_THIRD_IF_RF_OFFSET=0xd0000
CONFIG_MTK_WIFI7_MT_WIFI=m
CONFIG_MTK_WIFI7_MT_WIFI_PATH="mt_wifi"
CONFIG_MTK_WIFI7_HWIFI_SUPPORT=y
CONFIG_MTK_WIFI7_PROXYARP_SUPPORT=y
CONFIG_MTK_WIFI7_OFFCHANNEL_SUPPORT=y
CONFIG_MTK_WIFI7_BS_MAP_BL_SUPPORT=y
# CONFIG_MTK_WIFI7_PWHM_SUPPORT is not set
CONFIG_MTK_WIFI7_FIRST_IF_EEPROM_FLASH=y
CONFIG_MTK_WIFI7_RT_FIRST_IF_RF_OFFSET=0xc0000
CONFIG_MTK_WIFI7_RT_SECOND_IF_RF_OFFSET=0xc8000
CONFIG_MTK_WIFI7_RT_THIRD_IF_RF_OFFSET=0xd0000
CONFIG_MTK_WIFI7_MULTI_INF_SUPPORT=y
CONFIG_MTK_WIFI7_BASIC_FUNC=y
CONFIG_MTK_WIFI7_DOT11_VHT_AC=y
CONFIG_MTK_WIFI7_DOT11_HE_AX=y
CONFIG_MTK_WIFI7_DOT11_EHT_BE=y
CONFIG_MTK_WIFI7_CFG_SUPPORT_FALCON_MURU=y
CONFIG_MTK_WIFI7_CFG_SUPPORT_FALCON_TXCMD_DBG=y
CONFIG_MTK_WIFI7_CFG_SUPPORT_FALCON_SR=y
CONFIG_MTK_WIFI7_CFG_SUPPORT_FALCON_PP=y
CONFIG_MTK_WIFI7_WIFI_TWT_SUPPORT=y
CONFIG_MTK_WIFI7_G_BAND_256QAM_SUPPORT=y
CONFIG_MTK_WIFI7_TPC_SUPPORT=y
CONFIG_MTK_WIFI7_ICAP_SUPPORT=y
CONFIG_MTK_WIFI7_SPECTRUM_SUPPORT=y
CONFIG_MTK_WIFI7_PHY_ICS_SUPPORT=y
CONFIG_MTK_WIFI7_BACKGROUND_SCAN_SUPPORT=y
CONFIG_MTK_WIFI7_SMART_CARRIER_SENSE_SUPPORT=y
CONFIG_MTK_WIFI7_SCS_FW_OFFLOAD=y
CONFIG_MTK_WIFI7_MT_DFS_SUPPORT=y
CONFIG_MTK_WIFI7_OFFCHANNEL_SCAN_FEATURE=y
CONFIG_MTK_WIFI7_HDR_TRANS_TX_SUPPORT=y
CONFIG_MTK_WIFI7_HDR_TRANS_RX_SUPPORT=y
CONFIG_MTK_WIFI7_DBDC_MODE=y
CONFIG_MTK_WIFI7_MULTI_PROFILE_SUPPORT=y
CONFIG_MTK_WIFI7_WSC_INCLUDED=y
CONFIG_MTK_WIFI7_WSC_V2_SUPPORT=y
CONFIG_MTK_WIFI7_DOT11W_PMF_SUPPORT=y
CONFIG_MTK_WIFI7_TXBF_SUPPORT=y
CONFIG_MTK_WIFI7_FAST_NAT_SUPPORT=y
CONFIG_MTK_WIFI7_WHNAT_SUPPORT=m
CONFIG_MTK_WIFI7_WARP_V2=y
CONFIG_MTK_WIFI7_RTMP_FLASH_SUPPORT=y
CONFIG_MTK_WIFI7_CAL_BIN_FILE_SUPPORT=y
CONFIG_MTK_WIFI7_ATE_SUPPORT=y
CONFIG_MTK_WIFI7_WLAN_SERVICE=y
CONFIG_MTK_WIFI7_PASSPOINT_R2=y
CONFIG_MTK_WIFI7_MBO_SUPPORT=y
CONFIG_MTK_WIFI7_OCE_SUPPORT=y
CONFIG_MTK_WIFI7_MAP_SUPPORT=y
CONFIG_MTK_WIFI7_UAPSD=y
CONFIG_MTK_WIFI7_HIGH_PRIO_QUEUE_SUPPORT=y
CONFIG_MTK_WIFI7_RED_SUPPORT=y
CONFIG_MTK_WIFI7_CTXD_MEM_CPY_SUPPORT=y
CONFIG_MTK_WIFI7_FIRST_IF_IPAILNA=y
CONFIG_MTK_WIFI7_SECOND_IF_IPAILNA=y
CONFIG_MTK_WIFI7_THIRD_IF_IPAILNA=y
CONFIG_MTK_WIFI7_FW_BIN_LOAD=y
CONFIG_MTK_WIFI7_SKU_TYPE="BE14000"
CONFIG_MTK_WIFI7_FW_LOG_TYPE="string_log"
CONFIG_MTK_WIFI7_2ADIE_TRIBAND=y
CONFIG_MTK_WIFI7_RTMP_PCI_SUPPORT=y
CONFIG_MTK_WIFI7_TR181_SUPPORT=y
CONFIG_MTK_WIFI7_CSI_SUPPORT=y
CONFIG_MTK_WIFI7_MODE_AP=m
CONFIG_MTK_WIFI7_MT_AP_SUPPORT=m
CONFIG_MTK_WIFI7_WDS_SUPPORT=y
CONFIG_MTK_WIFI7_MBSS_SUPPORT=y
CONFIG_MTK_WIFI7_APCLI_SUPPORT=y
CONFIG_MTK_WIFI7_APCLI_CERT_SUPPORT=y
CONFIG_MTK_WIFI7_MAC_REPEATER_SUPPORT=y
CONFIG_MTK_WIFI7_MWDS=y
CONFIG_MTK_WIFI7_MUMIMO_SUPPORT=y
CONFIG_MTK_WIFI7_MU_RA_SUPPORT=y
CONFIG_MTK_WIFI7_DOT11R_FT_SUPPORT=y
CONFIG_MTK_WIFI7_DOT11K_RRM_SUPPORT=y
CONFIG_MTK_WIFI7_MLME_MULTI_QUEUE_SUPPORT=y
CONFIG_MTK_WIFI7_EAP_FEATURE=y
CONFIG_MTK_WIFI7_VLAN_SUPPORT=y
CONFIG_MTK_WIFI7_SNIFFER_RADIOTAP_SUPPORT=y
CONFIG_MTK_WIFI7_ANTENNA_CONTROL_SUPPORT=y
CONFIG_MTK_WIFI7_MGMT_TXPWR_CTRL=y
CONFIG_MTK_WIFI7_RA_PHY_RATE_SUPPORT=y
CONFIG_MTK_WIFI7_AMPDU_CONF_SUPPORT=y
CONFIG_MTK_WIFI7_ACK_CTS_TIMEOUT_SUPPORT=y
CONFIG_MTK_WIFI7_TX_LATENCY_SUPPORT=y
CONFIG_MTK_WIFI7_DATA_TXPWR_CTRL=y
CONFIG_MTK_WIFI7_EAP_QUICK_CHANNEL_SWITCH_WITHOUT_CSA=y
CONFIG_MTK_WIFI7_DSCP_PRI_SUPPORT=y
CONFIG_MTK_WIFI7_QOS_R1_SUPPORT=y
CONFIG_MTK_WIFI7_OSAL_SUPPORT=y
# Build the WiFi7 cfg80211 backend as well as the separate OSAL adapter.
CONFIG_MTK_WIFI7_CFG80211_SUPPORT=y
CONFIG_PACKAGE_kmod-mt_wifi_osal=y
CONFIG_MTK_WIFI_OSAL_CFG80211_SUPPORT=y
CONFIG_MTK_WIFI7_CON_WPS_SUPPORT=y
CONFIG_MTK_WIFI7_MCAST_RATE_SPECIFIC=y
CONFIG_MTK_WIFI7_BAND_STEERING=y
CONFIG_MTK_WIFI7_VOW_SUPPORT=y
CONFIG_MTK_WIFI7_LED_CONTROL_SUPPORT=y
CONFIG_MTK_WIFI7_WLAN_HOOK=y
CONFIG_MTK_WIFI7_GREENAP_SUPPORT=y
CONFIG_MTK_WIFI7_PCIE_ASPM_DYM_CTRL_SUPPORT=y
CONFIG_MTK_WIFI7_AIR_MONITOR=y
CONFIG_MTK_WIFI7_WNM_SUPPORT=y
CONFIG_MTK_WIFI7_INTERWORKING=y
CONFIG_MTK_WIFI7_WPA3_SUPPORT=y
CONFIG_MTK_WIFI7_OWE_SUPPORT=y
CONFIG_MTK_WIFI7_RSNO_SUPPORT=y
CONFIG_MTK_WIFI7_SINGLE_SKU=y
CONFIG_MTK_WIFI7_6G_SUPPORT=y
CONFIG_MTK_WIFI7_UNIFIED_COUNTRY_CONFIG_SUPPORT=y
CONFIG_MTK_WIFI7_IGMP_SNOOP_SUPPORT=y
CONFIG_MTK_WIFI7_RTMP_WLAN_HOOK_SUPPORT=y
# CONFIG_MTK_WIFI7_PROFILING_SUPPORT is not set
CONFIG_PACKAGE_wifi-dats=y
CONFIG_first_card=y
CONFIG_first_card_name="MT7990"
CONFIG_second_card=y
CONFIG_second_card_name="MT7990"

# Core service set trimmed to packages that are present in current feeds.
CONFIG_PACKAGE_autocore-arm=y
CONFIG_PACKAGE_block-mount=y
CONFIG_PACKAGE_ca-bundle=y
CONFIG_PACKAGE_ca-certificates=y
CONFIG_PACKAGE_dnsmasq-full=y
CONFIG_PACKAGE_ip-full=y
CONFIG_PACKAGE_jq=y
CONFIG_PACKAGE_jsonfilter=y
CONFIG_PACKAGE_libiconv-full=y
CONFIG_PACKAGE_libncurses=y
CONFIG_PACKAGE_libopenssl=y
CONFIG_PACKAGE_libpthread=y
CONFIG_PACKAGE_libreadline=y
CONFIG_PACKAGE_librt=y
CONFIG_PACKAGE_rpcd-mod-ucode=y
CONFIG_PACKAGE_tar=y
CONFIG_PACKAGE_ucode-mod-digest=y
CONFIG_PACKAGE_ucode-mod-socket=y
CONFIG_PACKAGE_unzip=y
CONFIG_PACKAGE_wget-ssl=y
CONFIG_PACKAGE_wireless-tools=y
CONFIG_PACKAGE_xz-utils=y
CONFIG_PACKAGE_zlib=y
# LuCI core + stable apps.
CONFIG_LUCI_LANG_zh_Hans=y
CONFIG_PACKAGE_luci-compat=y
CONFIG_PACKAGE_luci-lib-chartjs=y
CONFIG_PACKAGE_luci-ssl-openssl=y
CONFIG_PACKAGE_luci-app-firewall=y
CONFIG_PACKAGE_luci-app-mtwifi-cfg=y
CONFIG_PACKAGE_rpcd-mod-router-status=y
CONFIG_PACKAGE_luci-i18n-base-zh-cn=y
```

## patches/filogic/mtk/Kconfig
```kconfig
# SPDX-License-Identifier: GPL-2.0-only
config NET_VENDOR_MEDIATEK
	bool "MediaTek devices"
	depends on ARCH_MEDIATEK || ARCH_AIROHA || SOC_MT7621 || SOC_MT7620 || COMPILE_TEST
	help
	  If you have a Mediatek SoC with ethernet, say Y.

if NET_VENDOR_MEDIATEK

config NET_AIROHA
	tristate "Airoha SoC Gigabit Ethernet support"
	depends on NET_DSA || !NET_DSA
	select PAGE_POOL
	help
	  This driver supports the gigabit ethernet MACs in the
	  Airoha SoC family.

config NET_MEDIATEK_SOC_WED
	depends on ARCH_MEDIATEK || COMPILE_TEST
	def_bool NET_MEDIATEK_SOC != n

config NET_MEDIATEK_SOC
	tristate "MediaTek SoC Gigabit Ethernet support"
	depends on NET_DSA || !NET_DSA
	select PINCTRL
	select PHYLINK
	select DIMLIB
	select PAGE_POOL
	select PAGE_POOL_STATS
	select PCS_MTK_LYNXI
	select REGMAP_MMIO
	help
	  This driver supports the gigabit ethernet MACs in the
	  MediaTek SoC family.

config NET_MEDIATEK_STAR_EMAC
	tristate "MediaTek STAR Ethernet MAC support"
	select PHYLIB
	select REGMAP_MMIO
	help
	  This driver supports the ethernet MAC IP first used on
	  MediaTek MT85** SoCs.

config MEDIATEK_NETSYS_V2
	tristate "MediaTek Ethernet NETSYS V2 support"
	depends on ARCH_MEDIATEK && NET_MEDIATEK_SOC
	help
	  This options enable MTK Ethernet NETSYS V2 support

config MEDIATEK_NETSYS_V3
	tristate "MediaTek Ethernet NETSYS V3 support"
	depends on ARCH_MEDIATEK && NET_MEDIATEK_SOC
	help
	  This options enable MTK Ethernet NETSYS V3 support for
	  XGMAC and USXGMII.

config NET_MEDIATEK_HNAT
	tristate "MediaTek HW NAT support"
	depends on NET_MEDIATEK_SOC
	select NETFILTER
	select NF_CONNTRACK
	select IP_NF_NAT
	help
	  This driver supports the Hardware Network Address Translation
	  in the MediaTek MT7988/MT7986/MT7981 chipset family.

endif #NET_VENDOR_MEDIATEK
```
