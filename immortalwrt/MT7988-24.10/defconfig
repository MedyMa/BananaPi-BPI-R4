## immortalwrt/mediatek/defconfig
```kconfig
# ImmortalWrt openwrt-24.10 defconfig for BananaPi BPI-R4.
# This keeps the upstream MTK WiFi 7 target block, but trims package
# selections to what the current workflow and diy feed script actually provide.

CONFIG_TARGET_mediatek=y
CONFIG_TARGET_mediatek_filogic=y
CONFIG_TARGET_mediatek_filogic_DEVICE_bananapi_bpi-r4=y
CONFIG_DEFAULT_kmod-mediatek_hnat=y
CONFIG_DEVEL=y
CONFIG_CCACHE=y
CONFIG_TOOLCHAINOPTS=y
# CONFIG_TARGET_ROOTFS_INITRAMFS is not set
CONFIG_TARGET_ROOTFS_PARTSIZE=8192
CONFIG_UNETD_VXLAN_SUPPORT=y
CONFIG_VPNC_GNUTLS=y
CONFIG_ZRAM_DEF_COMP_LZORLE=y
CONFIG_IPV6=y
CONFIG_DRIVER_11AC_SUPPORT=y
CONFIG_DRIVER_11AX_SUPPORT=y
CONFIG_DRIVER_11BE_SUPPORT=y

# Keep the nftables firewall / IPv6 userspace explicit.
CONFIG_PACKAGE_firewall4=y
CONFIG_PACKAGE_odhcp6c=y
CONFIG_PACKAGE_odhcpd-ipv6only=y
```
