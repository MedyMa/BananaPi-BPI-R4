## immortalwrt/MT7988-24.10/defconfig
```kconfig
# ImmortalWrt openwrt-24.10 defconfig for BananaPi BPI-R4.
# This profile is kept separate from the mt798x-mt799x-6.6-mtwifi draft config
# so 24.10-specific package selections can diverge without affecting MT7988-Action.
# Keep the vendor WiFi 7 layout, but let mt_wifi7 own the integrated WARP path.

CONFIG_TARGET_mediatek=y
CONFIG_TARGET_mediatek_filogic=y
CONFIG_TARGET_mediatek_filogic_DEVICE_bananapi_bpi-r4=y
CONFIG_PACKAGE_kmod-mediatek_hnat=y
CONFIG_DEVEL=y
CONFIG_CCACHE=y
CONFIG_TOOLCHAINOPTS=y
# CONFIG_TARGET_ROOTFS_INITRAMFS is not set
CONFIG_TARGET_ROOTFS_PARTSIZE=8192
CONFIG_UNETD_VXLAN_SUPPORT=y
CONFIG_VPNC_GNUTLS=y
CONFIG_ZRAM_DEF_COMP_LZORLE=y
CONFIG_IPV6=y
CONFIG_DRIVER_11AC_SUPPORT=y
CONFIG_DRIVER_11AX_SUPPORT=y
CONFIG_DRIVER_11BE_SUPPORT=y
# Keep the upstream mt76/mt7996 path out of the vendor WiFi7 build.
# CONFIG_PACKAGE_kmod-mt7996-firmware is not set
# CONFIG_PACKAGE_kmod-mt7996-233-firmware is not set

# Keep the nftables firewall / IPv6 userspace explicit.
CONFIG_PACKAGE_firewall4=y
CONFIG_PACKAGE_odhcp6c=y
CONFIG_PACKAGE_odhcpd-ipv6only=y
CONFIG_PACKAGE_iptables-nft=y
CONFIG_PACKAGE_ip6tables-nft=y
CONFIG_PACKAGE_ppp=y
CONFIG_PACKAGE_ppp-mod-pppoe=y

# MTK vendor WiFi 7 block aligned to mt798x-mt799x-6.6-mtwifi.
CONFIG_PACKAGE_datconf=y
CONFIG_PACKAGE_datconf-lua=y
CONFIG_PACKAGE_mii_mgr=y
CONFIG_PACKAGE_mtk-smp=y
CONFIG_PACKAGE_mtkhqos_util=y
CONFIG_PACKAGE_mtwifi-cfg=y
CONFIG_PACKAGE_mtwifi-wapp=y
CONFIG_PACKAGE_regs=y
CONFIG_PACKAGE_switch=y
CONFIG_PACKAGE_kmod-cfg80211=y
CONFIG_PACKAGE_kmod-mac80211=y
CONFIG_PACKAGE_kmod-mt_hwifi=y
CONFIG_MTK_HWIFI_PCI_SUPPORT=y
CONFIG_MTK_HWIFI_CONNAC_IF_SUPPORT=y
CONFIG_MTK_HWIFI_WED_SUPPORT=y
CONFIG_MTK_HWIFI_FW_BE14000=y
CONFIG_MTK_HWIFI_FW_BE14000_20260311=y
CONFIG_MTK_HWIFI_MT7990=y
CONFIG_MTK_HWIFI_MT7991=y
CONFIG_PACKAGE_kmod-connac_if=y
CONFIG_PACKAGE_kmod-mt7990=y
CONFIG_MTK_HWIFI_MT7990_RRO_SUPPORT="N"
CONFIG_MTK_HWIFI_MT7990_OPTION_TYPE=2
CONFIG_MTK_HWIFI_MT7990_INTR_OPTION_SET=0
CONFIG_PACKAGE_kmod-mt7991=y
CONFIG_PACKAGE_kmod-mtk_pci=y
CONFIG_PACKAGE_kmod-mt_wifi_cmn=y
CONFIG_PACKAGE_kmod-mtk_wed=y
CONFIG_PACKAGE_kmod-mt_wifi7=y
CONFIG_PACKAGE_mt7988-wo-firmware=y
CONFIG_MTK_WIFI7_SUPPORT_OPENWRT=y
CONFIG_MTK_WIFI7_DRIVER=y
CONFIG_MTK_WIFI7_UNIFIED_COMMAND=y
CONFIG_MTK_WIFI7_DOT11_N_SUPPORT=y
CONFIG_MTK_WIFI7_DOT11_AX_SUPPORT=y
CONFIG_MTK_WIFI7_DOT11_BE_SUPPORT=y
CONFIG_MTK_WIFI7_MT_MAC=y
CONFIG_MTK_WIFI7_CHIP_MT7990=y
CONFIG_MTK_WIFI7_FIRST_IF_MT7990=y
CONFIG_MTK_WIFI7_SECOND_IF_MT7990=y
CONFIG_MTK_THIRD_IF_MT7990=y
CONFIG_MTK_WIFI7_FIRST_IF_RF_OFFSET=0xc0000
CONFIG_MTK_WIFI7_SECOND_IF_RF_OFFSET=0xc8000
CONFIG_MTK_WIIF7_THIRD_IF_RF_OFFSET=0xd0000
CONFIG_MTK_WIFI7_MT_WIFI=m
CONFIG_MTK_WIFI7_MT_WIFI_PATH="mt_wifi"
CONFIG_MTK_WIFI7_HWIFI_SUPPORT=y
CONFIG_MTK_WIFI7_PROXYARP_SUPPORT=y
CONFIG_MTK_WIFI7_OFFCHANNEL_SUPPORT=y
CONFIG_MTK_WIFI7_BS_MAP_BL_SUPPORT=y
# CONFIG_MTK_WIFI7_PWHM_SUPPORT is not set
CONFIG_MTK_WIFI7_FIRST_IF_EEPROM_FLASH=y
CONFIG_MTK_WIFI7_RT_FIRST_IF_RF_OFFSET=0xc0000
CONFIG_MTK_WIFI7_RT_SECOND_IF_RF_OFFSET=0xc8000
CONFIG_MTK_WIFI7_RT_THIRD_IF_RF_OFFSET=0xd0000
CONFIG_MTK_WIFI7_MULTI_INF_SUPPORT=y
CONFIG_MTK_WIFI7_BASIC_FUNC=y
CONFIG_MTK_WIFI7_DOT11_VHT_AC=y
CONFIG_MTK_WIFI7_DOT11_HE_AX=y
CONFIG_MTK_WIFI7_DOT11_EHT_BE=y
CONFIG_MTK_WIFI7_CFG_SUPPORT_FALCON_MURU=y
CONFIG_MTK_WIFI7_CFG_SUPPORT_FALCON_TXCMD_DBG=y
CONFIG_MTK_WIFI7_CFG_SUPPORT_FALCON_SR=y
CONFIG_MTK_WIFI7_CFG_SUPPORT_FALCON_PP=y
CONFIG_MTK_WIFI7_WIFI_TWT_SUPPORT=y
CONFIG_MTK_WIFI7_G_BAND_256QAM_SUPPORT=y
CONFIG_MTK_WIFI7_TPC_SUPPORT=y
CONFIG_MTK_WIFI7_ICAP_SUPPORT=y
CONFIG_MTK_WIFI7_SPECTRUM_SUPPORT=y
CONFIG_MTK_WIFI7_PHY_ICS_SUPPORT=y
CONFIG_MTK_WIFI7_BACKGROUND_SCAN_SUPPORT=y
CONFIG_MTK_WIFI7_SMART_CARRIER_SENSE_SUPPORT=y
CONFIG_MTK_WIFI7_SCS_FW_OFFLOAD=y
CONFIG_MTK_WIFI7_MT_DFS_SUPPORT=y
CONFIG_MTK_WIFI7_OFFCHANNEL_SCAN_FEATURE=y
CONFIG_MTK_WIFI7_HDR_TRANS_TX_SUPPORT=y
CONFIG_MTK_WIFI7_HDR_TRANS_RX_SUPPORT=y
CONFIG_MTK_WIFI7_DBDC_MODE=y
CONFIG_MTK_WIFI7_MULTI_PROFILE_SUPPORT=y
CONFIG_MTK_WIFI7_WSC_INCLUDED=y
CONFIG_MTK_WIFI7_WSC_V2_SUPPORT=y
CONFIG_MTK_WIFI7_DOT11W_PMF_SUPPORT=y
CONFIG_MTK_WIFI7_TXBF_SUPPORT=y
CONFIG_MTK_WIFI7_FAST_NAT_SUPPORT=y
CONFIG_MTK_WIFI7_WHNAT_SUPPORT=m
CONFIG_MTK_WIFI7_WARP_V2=y
CONFIG_MTK_WIFI7_RTMP_FLASH_SUPPORT=y
CONFIG_MTK_WIFI7_CAL_BIN_FILE_SUPPORT=y
CONFIG_MTK_WIFI7_ATE_SUPPORT=y
CONFIG_MTK_WIFI7_WLAN_SERVICE=y
CONFIG_MTK_WIFI7_PASSPOINT_R2=y
CONFIG_MTK_WIFI7_MBO_SUPPORT=y
CONFIG_MTK_WIFI7_MAP_SUPPORT=y
CONFIG_MTK_WIFI7_UAPSD=y
CONFIG_MTK_WIFI7_HIGH_PRIO_QUEUE_SUPPORT=y
CONFIG_MTK_WIFI7_CTXD_MEM_CPY_SUPPORT=y
CONFIG_MTK_WIFI7_FIRST_IF_IPAILNA=y
CONFIG_MTK_WIFI7_SECOND_IF_IPAILNA=y
CONFIG_MTK_WIFI7_THIRD_IF_IPAILNA=y
CONFIG_MTK_WIFI7_FW_BIN_LOAD=y
CONFIG_MTK_WIFI7_SKU_TYPE="BE14000"
CONFIG_MTK_WIFI7_FW_LOG_TYPE="string_log"
CONFIG_MTK_WIFI7_2ADIE_TRIBAND=y
CONFIG_MTK_WIFI7_RTMP_PCI_SUPPORT=y
CONFIG_MTK_WIFI7_TR181_SUPPORT=y
CONFIG_MTK_WIFI7_CSI_SUPPORT=y
CONFIG_MTK_WIFI7_MODE_AP=m
CONFIG_MTK_WIFI7_MT_AP_SUPPORT=m
CONFIG_MTK_WIFI7_WDS_SUPPORT=y
CONFIG_MTK_WIFI7_MBSS_SUPPORT=y
CONFIG_MTK_WIFI7_APCLI_SUPPORT=y
CONFIG_MTK_WIFI7_APCLI_CERT_SUPPORT=y
CONFIG_MTK_WIFI7_MAC_REPEATER_SUPPORT=y
CONFIG_MTK_WIFI7_MWDS=y
CONFIG_MTK_WIFI7_MUMIMO_SUPPORT=y
CONFIG_MTK_WIFI7_MU_RA_SUPPORT=y
CONFIG_MTK_WIFI7_DOT11R_FT_SUPPORT=y
CONFIG_MTK_WIFI7_DOT11K_RRM_SUPPORT=y
CONFIG_MTK_WIFI7_MLME_MULTI_QUEUE_SUPPORT=y
CONFIG_MTK_WIFI7_EAP_FEATURE=y
CONFIG_MTK_WIFI7_VLAN_SUPPORT=y
CONFIG_MTK_WIFI7_SNIFFER_RADIOTAP_SUPPORT=y
CONFIG_MTK_WIFI7_ANTENNA_CONTROL_SUPPORT=y
CONFIG_MTK_WIFI7_MGMT_TXPWR_CTRL=y
CONFIG_MTK_WIFI7_RA_PHY_RATE_SUPPORT=y
CONFIG_MTK_WIFI7_AMPDU_CONF_SUPPORT=y
CONFIG_MTK_WIFI7_ACK_CTS_TIMEOUT_SUPPORT=y
CONFIG_MTK_WIFI7_TX_LATENCY_SUPPORT=y
CONFIG_MTK_WIFI7_DATA_TXPWR_CTRL=y
CONFIG_MTK_WIFI7_EAP_QUICK_CHANNEL_SWITCH_WITHOUT_CSA=y
CONFIG_MTK_WIFI7_DSCP_PRI_SUPPORT=y
CONFIG_MTK_WIFI7_QOS_R1_SUPPORT=y
CONFIG_MTK_WIFI7_CON_WPS_SUPPORT=y
CONFIG_MTK_WIFI7_MCAST_RATE_SPECIFIC=y
CONFIG_MTK_WIFI7_BAND_STEERING=y
CONFIG_MTK_WIFI7_LED_CONTROL_SUPPORT=y
CONFIG_MTK_WIFI7_WLAN_HOOK=y
CONFIG_MTK_WIFI7_GREENAP_SUPPORT=y
CONFIG_MTK_WIFI7_PCIE_ASPM_DYM_CTRL_SUPPORT=y
CONFIG_MTK_WIFI7_AIR_MONITOR=y
CONFIG_MTK_WIFI7_WNM_SUPPORT=y
CONFIG_MTK_WIFI7_INTERWORKING=y
CONFIG_MTK_WIFI7_WPA3_SUPPORT=y
CONFIG_MTK_WIFI7_OWE_SUPPORT=y
CONFIG_MTK_WIFI7_RSNO_SUPPORT=y
CONFIG_MTK_WIFI7_SINGLE_SKU=y
CONFIG_MTK_WIFI7_6G_SUPPORT=y
CONFIG_MTK_WIFI7_UNIFIED_COUNTRY_CONFIG_SUPPORT=y
CONFIG_MTK_WIFI7_IGMP_SNOOP_SUPPORT=y
CONFIG_MTK_WIFI7_RTMP_WLAN_HOOK_SUPPORT=y
CONFIG_PACKAGE_wifi-dats=y
CONFIG_first_card=y
CONFIG_first_card_name="MT7990"
CONFIG_second_card=y
CONFIG_second_card_name="MT7990"

# 5G / WWAN / SFP bring-up and diagnostics.
CONFIG_MODEMMANAGER_WITH_MBIM=y
CONFIG_MODEMMANAGER_WITH_QMI=y
CONFIG_MODEMMANAGER_WITH_QRTR=y
CONFIG_PACKAGE_kmod-eeprom-at24=y
CONFIG_PACKAGE_kmod-hwmon-pwmfan=y
CONFIG_PACKAGE_kmod-i2c-mux-pca954x=y
CONFIG_PACKAGE_kmod-phy-aquantia=y
CONFIG_PACKAGE_kmod-phy-marvell-10g=y
CONFIG_PACKAGE_kmod-phy-realtek=y
CONFIG_PACKAGE_kmod-rtc-pcf8563=y
CONFIG_PACKAGE_kmod-sfp=y
CONFIG_PACKAGE_kmod-usb3=y
CONFIG_PACKAGE_kmod-usb-serial-option=y
CONFIG_PACKAGE_kmod-usb-serial-qualcomm=y
CONFIG_PACKAGE_kmod-usb-acm=y
CONFIG_PACKAGE_kmod-usb-wdm=y
CONFIG_PACKAGE_kmod-usb-net-cdc-mbim=y
CONFIG_PACKAGE_kmod-usb-net-qmi-wwan=y
CONFIG_PACKAGE_kmod-usb-net-qmi-wwan-fibocom=y
CONFIG_PACKAGE_kmod-pcie_mhi=y
CONFIG_PACKAGE_kmod-mhi-bus=y
CONFIG_PACKAGE_kmod-mhi-wwan-mbim=y
CONFIG_PACKAGE_kmod-wwan=y
CONFIG_PACKAGE_kmod-qrtr-mhi=y
CONFIG_PACKAGE_kmod-mtk-t7xx=y
CONFIG_PACKAGE_usbmode=y
CONFIG_PACKAGE_ethtool-full=y
CONFIG_PACKAGE_pciids=y
CONFIG_PACKAGE_pciutils=y
CONFIG_PACKAGE_usbids=y
CONFIG_PACKAGE_usbutils=y
CONFIG_PACKAGE_tcpdump-mini=y
CONFIG_PACKAGE_blkid=y
CONFIG_PACKAGE_btrfs-progs=y
CONFIG_PACKAGE_dosfstools=y
CONFIG_PACKAGE_e2fsprogs=y
CONFIG_PACKAGE_exfat-fsck=y
CONFIG_PACKAGE_exfat-mkfs=y
CONFIG_PACKAGE_lsblk=y
CONFIG_PACKAGE_mount-utils=y
CONFIG_PACKAGE_kmod-fs-exfat=y
CONFIG_PACKAGE_kmod-fs-msdos=y
CONFIG_PACKAGE_kmod-fs-ntfs3=y
CONFIG_PACKAGE_kmod-nls-cp932=y
CONFIG_PACKAGE_kmod-nls-cp936=y
CONFIG_PACKAGE_kmod-nls-cp950=y
CONFIG_PACKAGE_kmod-nls-utf8=y
CONFIG_PACKAGE_parted=y
CONFIG_PACKAGE_smartmontools=y
CONFIG_PACKAGE_kmod-nvme=y

# Core service set trimmed to packages that are present in current feeds.
CONFIG_PACKAGE_adguardhome=y
CONFIG_PACKAGE_alsa-utils=y
CONFIG_PACKAGE_aria2=y
CONFIG_PACKAGE_ariang=y
CONFIG_PACKAGE_bash=y
CONFIG_PACKAGE_autocore-arm=y
CONFIG_PACKAGE_block-mount=y
CONFIG_PACKAGE_ca-bundle=y
CONFIG_PACKAGE_ca-certificates=y
CONFIG_PACKAGE_cgroupfs-mount=y
CONFIG_PACKAGE_cloudflared=y
CONFIG_PACKAGE_containerd=y
CONFIG_PACKAGE_cpufreq=y
CONFIG_PACKAGE_curl=y
CONFIG_PACKAGE_ddns-scripts-services=y
CONFIG_PACKAGE_ddnsto=y
CONFIG_PACKAGE_dnsmasq-full=y
CONFIG_PACKAGE_docker=y
CONFIG_PACKAGE_docker-compose=y
CONFIG_PACKAGE_dockerd=y
CONFIG_PACKAGE_fibocom-dial=y
CONFIG_PACKAGE_frpc=y
CONFIG_PACKAGE_geoview=y
CONFIG_PACKAGE_haproxy=y
CONFIG_PACKAGE_hysteria=y
CONFIG_PACKAGE_ip-full=y
CONFIG_PACKAGE_ipset=y
CONFIG_PACKAGE_iputils-arping=y
CONFIG_PACKAGE_jq=y
CONFIG_PACKAGE_jsonfilter=y
CONFIG_PACKAGE_kmod-dummy=y
CONFIG_PACKAGE_kmod-inet-diag=y
CONFIG_PACKAGE_kmod-nft-socket=y
CONFIG_PACKAGE_kmod-nft-tproxy=y
CONFIG_PACKAGE_kmod-tun=y
CONFIG_PACKAGE_libiconv-full=y
CONFIG_PACKAGE_libncurses=y
CONFIG_PACKAGE_libopenssl=y
CONFIG_PACKAGE_libpthread=y
CONFIG_PACKAGE_libreadline=y
CONFIG_PACKAGE_librt=y
CONFIG_PACKAGE_meig-cm=y
CONFIG_PACKAGE_mihomo=y
CONFIG_PACKAGE_miniupnpd-nftables=y
CONFIG_PACKAGE_modemband=y
CONFIG_PACKAGE_modemmanager=y
CONFIG_PACKAGE_mosdns=y
CONFIG_PACKAGE_netdata=y
CONFIG_PACKAGE_nikki=y
CONFIG_PACKAGE_nlbwmon=y
CONFIG_PACKAGE_openssl-util=y
CONFIG_PACKAGE_p910nd=y
CONFIG_PACKAGE_quectel-cm=y
CONFIG_PACKAGE_rpcd-mod-ucode=y
CONFIG_PACKAGE_runc=y
CONFIG_PACKAGE_ruby=y
CONFIG_PACKAGE_ruby-yaml=y
CONFIG_PACKAGE_shadowsocks-libev-config=y
CONFIG_PACKAGE_shadowsocks-libev-ss-local=y
CONFIG_PACKAGE_shadowsocks-libev-ss-redir=y
CONFIG_PACKAGE_shadowsocks-libev-ss-server=y
CONFIG_PACKAGE_shadowsocks-rust-sslocal=y
CONFIG_PACKAGE_shadowsocks-rust-ssserver=y
CONFIG_PACKAGE_shairport-sync-openssl=y
CONFIG_PACKAGE_shadow-tls=y
CONFIG_PACKAGE_simple-obfs-client=y
CONFIG_PACKAGE_sing-box=y
CONFIG_SING_BOX_BUILD_ACME=y
CONFIG_SING_BOX_BUILD_CLASH_API=y
CONFIG_SING_BOX_BUILD_ECH=y
CONFIG_SING_BOX_BUILD_GVISOR=y
CONFIG_SING_BOX_BUILD_QUIC=y
CONFIG_SING_BOX_BUILD_REALITY_SERVER=y
CONFIG_SING_BOX_BUILD_UTLS=y
CONFIG_SING_BOX_BUILD_WIREGUARD=y
CONFIG_PACKAGE_smartdns=y
CONFIG_PACKAGE_sms-tool=y
CONFIG_PACKAGE_softethervpn5-bridge=y
CONFIG_PACKAGE_softethervpn5-client=y
CONFIG_PACKAGE_softethervpn5-server=y
CONFIG_PACKAGE_sqm-scripts=y
CONFIG_PACKAGE_tcping=y
CONFIG_PACKAGE_ttyd=y
CONFIG_PACKAGE_tuic-client=y
CONFIG_PACKAGE_umbim=y
CONFIG_PACKAGE_ucode-mod-digest=y
CONFIG_PACKAGE_ucode-mod-socket=y
CONFIG_PACKAGE_unzip=y
CONFIG_PACKAGE_uqmi=y
CONFIG_PACKAGE_v2dat=y
CONFIG_PACKAGE_v2ray-geoip=y
CONFIG_PACKAGE_v2ray-geosite=y
CONFIG_PACKAGE_v2ray-plugin=y
CONFIG_PACKAGE_vlmcsd=y
CONFIG_PACKAGE_wget-ssl=y
CONFIG_PACKAGE_wsdd2=y
CONFIG_PACKAGE_wireless-tools=y
CONFIG_PACKAGE_wrtbwmon=y
CONFIG_PACKAGE_xray-core=y
CONFIG_PACKAGE_xray-plugin=y
CONFIG_PACKAGE_yq=y
CONFIG_PACKAGE_zlib=y

# LuCI core + stable apps.
CONFIG_LUCI_LANG_zh_Hans=y
CONFIG_PACKAGE_luci-compat=y
CONFIG_PACKAGE_luci-lib-chartjs=y
CONFIG_PACKAGE_luci-lib-docker=y
CONFIG_PACKAGE_luci-ssl-openssl=y
CONFIG_PACKAGE_luci-app-ddns=y
CONFIG_PACKAGE_luci-app-dockerman=y
CONFIG_PACKAGE_luci-app-filemanager=y
CONFIG_PACKAGE_luci-app-firewall=y
CONFIG_PACKAGE_luci-app-modemband=y
CONFIG_PACKAGE_luci-app-mtwifi-cfg=y
CONFIG_PACKAGE_luci-app-nlbwmon=y
CONFIG_PACKAGE_luci-app-samba4=y
CONFIG_PACKAGE_luci-app-sqm=y
CONFIG_PACKAGE_luci-app-ttyd=y
CONFIG_PACKAGE_luci-app-eqos-mtk=y
CONFIG_PACKAGE_luci-app-turboacc-mtk=y
CONFIG_PACKAGE_luci-app-upnp=y
CONFIG_PACKAGE_luci-app-wol=y
CONFIG_PACKAGE_luci-app-zerotier=y
CONFIG_PACKAGE_luci-i18n-base-zh-cn=y
CONFIG_PACKAGE_luci-proto-3g=y
CONFIG_PACKAGE_luci-proto-mbim=y
CONFIG_PACKAGE_luci-proto-modemmanager=y
CONFIG_PACKAGE_luci-proto-qmi=y
CONFIG_PACKAGE_luci-proto-quectel=y
CONFIG_PACKAGE_luci-proto-vpnc=y
CONFIG_PACKAGE_luci-proto-vxlan=y
CONFIG_PACKAGE_luci-proto-wireguard=y

# Community LuCI apps supplied by diy-part5.sh.
CONFIG_PACKAGE_luci-theme-argon=y
CONFIG_PACKAGE_luci-app-argon-config=y
CONFIG_PACKAGE_luci-app-adguardhome=y
CONFIG_PACKAGE_luci-app-fan=y
CONFIG_PACKAGE_luci-app-airplay2=y
CONFIG_PACKAGE_luci-app-aria2=y
CONFIG_PACKAGE_luci-app-cloudflared=y
CONFIG_PACKAGE_luci-app-commands=y
CONFIG_PACKAGE_luci-app-cpufreq=y
CONFIG_PACKAGE_luci-app-ddnsto=y
CONFIG_PACKAGE_luci-app-diskman=y
CONFIG_PACKAGE_luci-app-diskman_INCLUDE_btrfs_progs=y
CONFIG_PACKAGE_luci-app-diskman_INCLUDE_lsblk=y
CONFIG_PACKAGE_luci-app-frpc=y
CONFIG_PACKAGE_luci-app-homeproxy=y
CONFIG_PACKAGE_luci-app-mosdns=y
CONFIG_PACKAGE_luci-app-netdata=y
CONFIG_PACKAGE_luci-app-nikki=y
CONFIG_PACKAGE_luci-app-openclash=y
CONFIG_PACKAGE_luci-app-passwall=y
CONFIG_PACKAGE_luci-app-passwall_Iptables_Transparent_Proxy=n
CONFIG_PACKAGE_luci-app-passwall_Nftables_Transparent_Proxy=y
CONFIG_PACKAGE_luci-app-passwall_INCLUDE_Geoview=y
CONFIG_PACKAGE_luci-app-passwall_INCLUDE_Haproxy=y
CONFIG_PACKAGE_luci-app-passwall_INCLUDE_Hysteria=n
CONFIG_PACKAGE_luci-app-passwall_INCLUDE_NaiveProxy=n
CONFIG_PACKAGE_luci-app-passwall_INCLUDE_Shadowsocks_Libev_Client=y
CONFIG_PACKAGE_luci-app-passwall_INCLUDE_Shadowsocks_Libev_Server=y
CONFIG_PACKAGE_luci-app-passwall_INCLUDE_Shadowsocks_Rust_Client=y
CONFIG_PACKAGE_luci-app-passwall_INCLUDE_Shadowsocks_Rust_Server=n
CONFIG_PACKAGE_luci-app-passwall_INCLUDE_ShadowsocksR_Libev_Client=y
CONFIG_PACKAGE_luci-app-passwall_INCLUDE_ShadowsocksR_Libev_Server=n
CONFIG_PACKAGE_luci-app-passwall_INCLUDE_Shadow_TLS=n
CONFIG_PACKAGE_luci-app-passwall_INCLUDE_Simple_Obfs=y
CONFIG_PACKAGE_luci-app-passwall_INCLUDE_SingBox=y
CONFIG_PACKAGE_luci-app-passwall_INCLUDE_V2ray_Geodata=n
CONFIG_PACKAGE_luci-app-passwall_INCLUDE_V2ray_Plugin=y
CONFIG_PACKAGE_luci-app-passwall_INCLUDE_Xray=y
CONFIG_PACKAGE_luci-app-passwall_INCLUDE_Xray_Plugin=n
CONFIG_PACKAGE_luci-app-ramfree=y
CONFIG_PACKAGE_luci-app-sfp-status=y
CONFIG_PACKAGE_luci-app-softethervpn=y
CONFIG_PACKAGE_luci-app-smartdns=y
CONFIG_PACKAGE_luci-app-ssr-plus=y
CONFIG_PACKAGE_luci-app-ssr-plus_INCLUDE_Iptables_Transparent_Proxy=n
CONFIG_PACKAGE_luci-app-ssr-plus_INCLUDE_Nftables_Transparent_Proxy=y
CONFIG_PACKAGE_luci-app-ssr-plus_INCLUDE_NONE_V2RAY=n
CONFIG_PACKAGE_luci-app-ssr-plus_INCLUDE_Xray=y
CONFIG_PACKAGE_luci-app-ssr-plus_INCLUDE_ChinaDNS_NG=n
CONFIG_PACKAGE_luci-app-ssr-plus_INCLUDE_MosDNS=y
CONFIG_PACKAGE_luci-app-ssr-plus_INCLUDE_Hysteria=n
CONFIG_PACKAGE_luci-app-ssr-plus_INCLUDE_Tuic_Client=n
CONFIG_PACKAGE_luci-app-ssr-plus_INCLUDE_Mihomo=y
CONFIG_PACKAGE_luci-app-ssr-plus_INCLUDE_Shadow_TLS=n
CONFIG_PACKAGE_luci-app-ssr-plus_INCLUDE_Kcptun=n
CONFIG_PACKAGE_luci-app-ssr-plus_INCLUDE_NaiveProxy=n
CONFIG_PACKAGE_luci-app-ssr-plus_INCLUDE_Shadowsocks_NONE_Client=n
CONFIG_PACKAGE_luci-app-ssr-plus_INCLUDE_Shadowsocks_Rust_Client=y
CONFIG_PACKAGE_luci-app-ssr-plus_INCLUDE_Shadowsocks_NONE_Server=n
CONFIG_PACKAGE_luci-app-ssr-plus_INCLUDE_Shadowsocks_Rust_Server=y
CONFIG_PACKAGE_luci-app-ssr-plus_INCLUDE_Shadowsocks_Simple_Obfs=y
CONFIG_PACKAGE_luci-app-ssr-plus_INCLUDE_Shadowsocks_V2ray_Plugin=n
CONFIG_PACKAGE_luci-app-ssr-plus_INCLUDE_ShadowsocksR_Libev_Client=y
CONFIG_PACKAGE_luci-app-ssr-plus_INCLUDE_ShadowsocksR_Libev_Server=n
CONFIG_PACKAGE_luci-app-socat=y
CONFIG_PACKAGE_luci-app-usb-printer=y
CONFIG_PACKAGE_luci-app-vlmcsd=y
CONFIG_PACKAGE_luci-app-wechatpush=y
CONFIG_PACKAGE_luci-app-wrtbwmon=y

# Keep the SSR Libev client pieces, but leave the server off on aarch64 defaults.
CONFIG_PACKAGE_shadowsocksr-libev-ssr-local=y
CONFIG_PACKAGE_shadowsocksr-libev-ssr-redir=y
CONFIG_PACKAGE_shadowsocksr-libev-ssr-server=n

# Samba4 / discovery options kept explicit for the LuCI app.
CONFIG_PACKAGE_samba4-libs=y
CONFIG_PACKAGE_samba4-server=y
CONFIG_SAMBA4_SERVER_AVAHI=y
CONFIG_SAMBA4_SERVER_NETBIOS=y
CONFIG_SAMBA4_SERVER_VFS=y
CONFIG_SAMBA4_SERVER_WSDD2=y
```
